/* Fixed ed25519 vector with a 53-byte message, the length of a GRANDPA
 * localized precommit payload, so the microbenchmark hashes exactly what the
 * firmware hashes. Generated with libsodium on the host; the signature is
 * valid, which matters because an invalid one can be rejected early and would
 * time faster than the work being measured.
 *
 * EDGE holds the encodings that separate a correct verifier from a merely fast
 * one: the eight small-order points of the curve, a non-canonical field
 * element, and p-1/p/p+1. */

static const uint8_t VEC_MSG[53] = {
    0x01,0x08,0x0f,0x16,0x1d,0x24,0x2b,0x32,0x39,0x40,0x47,0x4e,
    0x55,0x5c,0x63,0x6a,0x71,0x78,0x7f,0x86,0x8d,0x94,0x9b,0xa2,
    0xa9,0xb0,0xb7,0xbe,0xc5,0xcc,0xd3,0xda,0xe1,0xe8,0xef,0xf6,
    0xfd,0x04,0x0b,0x12,0x19,0x20,0x27,0x2e,0x35,0x3c,0x43,0x4a,
    0x51,0x58,0x5f,0x66,0x6d,
};
static const uint8_t VEC_PK[32] = {
    0xa1,0x2f,0x2c,0x34,0xa7,0xa7,0x7c,0x40,0x10,0x5a,0x5f,0x2e,
    0x14,0xeb,0x43,0x93,0x22,0x64,0xb8,0x31,0x77,0xf4,0x09,0x01,
    0xb7,0xc9,0x0e,0xc3,0xa8,0x5e,0x4f,0x7e,
};
static const uint8_t VEC_SIG[64] = {
    0x45,0x11,0x58,0xb5,0x54,0x55,0x26,0x8f,0xb0,0x8d,0x43,0x35,
    0x20,0xb2,0xf2,0xb8,0xd4,0x7e,0x60,0x54,0x2a,0x6d,0x23,0x60,
    0x55,0xf9,0x90,0x48,0x23,0x0a,0xed,0x5e,0xba,0x1a,0x38,0x22,
    0xab,0xa5,0x7c,0x4c,0xf4,0xf5,0xd9,0x13,0x99,0x7b,0x00,0x75,
    0x76,0xa2,0x7c,0x56,0x45,0x6d,0xdd,0xdc,0xa1,0xab,0x22,0x31,
    0x7a,0xd4,0x36,0x0e,
};

static const uint8_t EDGE[][32] = {
    { 0x00 },
    { 0x01 },
    { 0xe0,0xeb,0x7a,0x7c,0x3b,0x41,0xb8,0xae,0x16,0x56,0xe3,0xfa,
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      0xff,0xff,0xff,0xff,0xff,0xff,0xff,0xff },
};
#define N_EDGE (sizeof EDGE / sizeof EDGE[0])
